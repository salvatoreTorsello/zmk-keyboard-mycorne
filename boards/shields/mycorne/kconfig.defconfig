## boards/shields/mycorne/kconfig.defconfig
```kconfig
if SHIELD_MYCORNE_LEFT

# Name must be less than 16 characters long!
config ZMK_KEYBOARD_NAME
    default "MyCorne"

config ZMK_SPLIT_ROLE_CENTRAL
    default y

endif

if SHIELD_MYCORNE_LEFT || SHIELD_MYCORNE_RIGHT

config ZMK_SPLIT
    default y

endif
```
